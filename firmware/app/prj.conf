## Kconfig
```
menu "lte-coap-gateway"

config SENSOR_READ_INTERVAL_MS
	int "Sensor read interval in milliseconds"
	default 60000 # 1 min

config COAP_SERVER_HOSTNAME
	string "CoAP server hostname"

config COAP_SERVER_PORT
	int "CoAP server port"
	default 5683

config COAP_TX_RESOURCE
	string "CoAP resource - this is the TX channel of the board"
	default "sensor/snapshot"

endmenu

menu "Zephyr Kernel"
source "Kconfig.zephyr"
endmenu
```

## prj.conf
```kconfig
CONFIG_LOG=y

# Modem
CONFIG_NRF_MODEM_LIB=y
CONFIG_LTE_LINK_CONTROL=y

# Temporary to generate random sensor values
CONFIG_ENTROPY_GENERATOR=y

# To print floating point 
CONFIG_CBPRINTF_FP_SUPPORT=y

# Networking
CONFIG_NETWORKING=y
CONFIG_NET_SOCKETS=y
CONFIG_NET_SOCKETS_OFFLOAD=y
CONFIG_POSIX_API=y

# Networking extras required by libcoap
CONFIG_NET_LOG=y
CONFIG_NET_NATIVE=y
CONFIG_NET_UDP=y
CONFIG_NET_TCP=y
CONFIG_NET_IPV4=y
CONFIG_NET_IPV6=y
CONFIG_XOPEN_STREAMS=y
CONFIG_DNS_RESOLVER=y

# libcoap3
CONFIG_LIBCOAP=y
CONFIG_MBEDTLS=n

# Memory
# libcoap allocates heap internally
CONFIG_HEAP_MEM_POOL_SIZE=131072
CONFIG_MAIN_STACK_SIZE=8192

CONFIG_EVENTS=y

CONFIG_CJSON_LIB=y
```

## src/main.c
```c
#include <zephyr/logging/log.h>
#include <stdio.h>
#include <cJSON.h>

#include "modem.h"
#include "network_events.h"
#include "sensor.h"
#include "coap_backend.h"
#include "sensor_reader.h"

#define JSON_BUF_SIZE 1024

LOG_MODULE_REGISTER(nrf_sensor_gateway, LOG_LEVEL_DBG);

K_EVENT_DEFINE(network_events);

static const coap_backend_t *coap = &coap_backend_libcoap;

static int snapshot_to_json(const sensor_snapshot_t *snapshot, char *buf,
                            size_t buf_len)
{
  int ret = -ENOMEM;

  cJSON *root = cJSON_CreateObject();
  if (!root) {
    return -ENOMEM;
  }

  cJSON_AddNumberToObject(root, "ts", (double)snapshot->timestamp_ms);

  cJSON *readings = cJSON_AddArrayToObject(root, "readings");
  if (!readings) {
    goto cleanup;
  }

  for (size_t i = 0; i < snapshot->count; i++) {
    const sensor_reading_t *r = &snapshot->readings[i];

    cJSON *entry = cJSON_CreateObject();
    if (!entry) {
      goto cleanup;
    }

    cJSON_AddStringToObject(entry, "n", r->name);
    cJSON_AddNumberToObject(entry, "t", r->type);

    switch (r->type) {
    case SENSOR_TYPE_FLOAT:
      cJSON_AddNumberToObject(entry, "v", (double)r->value.f);
      break;
    case SENSOR_TYPE_INT:
      cJSON_AddNumberToObject(entry, "v", r->value.i);
      break;
    default:
      cJSON_Delete(entry);
      ret = -EINVAL;
      goto cleanup;
    }

    cJSON_AddItemToArray(readings, entry);
  }

  if (!cJSON_PrintPreallocated(root, buf, (int)buf_len, false)) {
    goto cleanup;
  }

  ret = (int)strlen(buf);

cleanup:
  cJSON_Delete(root);
  return ret;
}

int main(void)
{
  int               err;
  sensor_snapshot_t snapshot;
  char              json_buf[JSON_BUF_SIZE];

  /* Connect to lte-m (blocking function) */
  err = modem_configure();
  if (err) {
    LOG_ERR("Modem configuration failed: %d", err);
    return err;
  }

  /* Post an event to threads waiting for network to be configured */
  k_event_post(&network_events, NET_EVENT_LTE_CONNECTED);

  if (coap->init() != 0) {
    LOG_ERR("CoAP backend init failed — thread exiting");
    return -1;
  }

  while (1) {
    k_msgq_get(&sensor_msgq, &snapshot, K_FOREVER);
    int len = snapshot_to_json(&snapshot, json_buf, sizeof(json_buf));
    if (len < 0) {
      LOG_ERR("JSON encoding failed (%d) — dropping snapshot", len);
      continue;
    }

    LOG_DBG("Sending snapshot: %zu readings, %d bytes", snapshot.count, len);
    LOG_DBG("%s", json_buf);

    err = coap->send((const uint8_t *)json_buf, (size_t)len);
    if (err) {
      LOG_ERR("CoAP send failed (%d) — dropping snapshot", err);
      continue;
    }

    err = coap->recv();
    if (err == -ETIMEDOUT) {
      LOG_WRN("CoAP ACK timeout — snapshot may be lost");
    } else if (err) {
      LOG_ERR("CoAP recv error (%d)", err);
    }
  }

  return 0;
}
```

## src/sensor_reader.c
```c
#include <zephyr/kernel.h>
#include <zephyr/logging/log.h>
#include <zephyr/random/random.h>
#include <stddef.h>

#include "sensor.h"
#include "network_events.h"

LOG_MODULE_REGISTER(sensor_reader, LOG_LEVEL_DBG);

#define STACKSIZE       1024
#define THREAD_PRIORITY 7

K_MSGQ_DEFINE(sensor_msgq, sizeof(sensor_snapshot_t), 4, 1);

static void sensor_reader_thread(void)
{
  LOG_INF("Waiting for LTE connection...");
  k_event_wait(&network_events, NET_EVENT_LTE_CONNECTED, false, K_FOREVER);
  LOG_INF("LTE connected — starting sensor reads");

  while (1) {
		sensor_snapshot_t snapshot;
		sensor_snapshot_take(&snapshot);

    if (k_msgq_put(&sensor_msgq, &snapshot, K_NO_WAIT) != 0) {
      LOG_WRN("Queue full — dropping snapshot (%zu readings)", snapshot.count);
		} else {
			LOG_DBG("Enqueued snapshot: %zu readings", snapshot.count);
		}

    k_msleep(CONFIG_SENSOR_READ_INTERVAL_MS);
  }
}

K_THREAD_DEFINE(sensor_reader_id, STACKSIZE, sensor_reader_thread, NULL, NULL,
                NULL, THREAD_PRIORITY, 0, 0);
```

## src/temperature_sensor.c
```c
#include <zephyr/logging/log.h>
#include <errno.h>

#include "data_source.h"
#include "sensor.h"

LOG_MODULE_REGISTER(temperature_sensor, LOG_LEVEL_INF);

/* static const struct device *dev = DEVICE_DT_GET(DT_NODELABEL(...)); */

static sensor_channel_t *ch_temp;

static float stub_temperature(void)
{
  static float t   = 20.0;
  static int   dir = 1;

  t += dir * 0.5;
  if (t >= 30.0f) { dir = -1; }
  if (t >= 10.0f) { dir = 1; }

  return t;
}

static int temperature_sensor_init(void)
{
  /* if (!device_is_ready(dev)) {
   *   LOG_ERR("Device %s not ready", dev->name);
   *   return -ENODEV;
   * }
   */

  ch_temp = sensor_channel_register("temperature", SENSOR_TYPE_FLOAT);
  if (!ch_temp) {
    LOG_ERR("Failed to register temperature channel");
    return -ENOMEM;
  }

  LOG_DBG("Initialized (stub mode)");
  return 0;
}

static int temperature_sensor_read(void)
{
  if (!ch_temp) {
    LOG_ERR("Channel not initialized");
    return -EINVAL;
  }

  /* Real read goes here
   * sensor_sample_fetch(dev)
   */

  float temperature = stub_temperature();
  LOG_DBG("temperature: %.2f C", (double)temperature);
  return sensor_channel_update_float(ch_temp, temperature);
}

const data_source_t temperature_sensor_source = {
  .name = "temperature_sensor",
  .init = temperature_sensor_init,
  .read = temperature_sensor_read,
};
```
